/*
 * Copyright (c) 2021 Mike "KemoNine" Crosson
 *
 * SPDX-License-Identifier: MIT
 */

#include <behaviors.dtsi>
#include <dt-bindings/zmk/keys.h>
#include <dt-bindings/zmk/bt.h>

// Left/Right
#define ARDUX_LEFT 1

// ARTS Row
#define KEY_N 3
#define KEY_I 2
#define KEY_A 1
#define KEY_R 0
// EYIO Row
#define KEY_E 7
#define KEY_O 6
#define KEY_T 5
#define KEY_SP 4


// Include main ardux.io keymap
#include "raintoe.dtsi"
