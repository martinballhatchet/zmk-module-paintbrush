/*
 * Copyright (c) 2021 Mike "KemoNine" Crosson
 *
 * SPDX-License-Identifier: MIT
 */

 /*

 * Heavily modified to make a new, different layout - "rain toe"
 * This is intended to just be an 8 key layout; not extended.
 * It's primarily left-handed. Might make a right-handed version later.
 * I like the concept of Big Ardux etc, but I don't need them and want to
 * concentrate on getting "rain toe" working first.


 * DONE: Remove big ardux
 * DONE: Remove right-handed for now
 * DONE: Remove leading nones stuff
 * DONE: Make sure it still builds
 * Note: At this point, even with the names of the keys changed, it's stil ardux
 * DONE: Next: swap in the RAIN TOE keys for ARTSEYIO - need SP <-> Y, N <-> S ?
 * DONE: All letters
 * TODO: Special characters
 * TODO: Special keys
 * TODO: Mouse move and nav
 * TODO: Numbers
 * TODO: Bluetooth?
 * TODO: Other layers
 * TODO: Functions (like numbers)
 * TODO: Put back right-handed? NIAR EOT :)
 * TODO: Macro for qu - search for Macro

 */

#include <behaviors.dtsi>
#include <dt-bindings/zmk/keys.h>
#include <dt-bindings/zmk/outputs.h>
#include <dt-bindings/zmk/pointing.h>


/*****************************************
 * ARDUX website : https://www.ardux.io
 * Primary reference : https://www.ardux.io/_FILES/images/ARDUX.jpg
*****************************************/

/*****************************************
 * Setting up ARDUX comboing
 *   - Enabled right OR left handed orientation
 *   - Please note: A/E key positions should be on your INDEX finger
 *     - The online reference is for right handed use
 *     - When using the ARDUX layout left handed you'll want to ensure your keypositions are flipped along the Y axis
 *   - Update/adjust the key positions using your boards keymap
 *     - See below for additional details
 *   - YOU MUST SET THE FOLLOWING CONFIG VALUES FOR THIS SETUP TO WORK PROPERLY IN YOUR BOARDS .conf FILE
 *     - CONFIG_ZMK_COMBO_MAX_COMBOS_PER_KEY=24
 *     - CONFIG_ZMK_COMBO_MAX_KEYS_PER_COMBO=8
 *     - CONFIG_ZMK_COMBO_MAX_PRESSED_COMBOS=8
 *****************************************/


/*****************************************
 * Define custom BT layer extra keys
 *
 * You can override the 2 blank keys on the BT select layer by copy/pasting the below into your keymap
 *     *before* including the ardux.dtsfile
 * Once added to your keymap you can adjust these 2 keys as you see fit
*****************************************/
#if !defined ARDUX_BT_TOP
#define ARDUX_BT_TOP &out OUT_BLE
#endif
#if !defined ARDUX_BT_BOTTOM
#define ARDUX_BT_BOTTOM &out OUT_USB
#endif

/*****************************************
 * Define how long it takes for the combos/holds to 'time out'
 * See documentation on "combos" for more detail
 * THE COMBO TIMEOUTS MUST BE THE SAME
 *    https://github.com/zmkfirmware/zmk/issues/905
 *****************************************/
#if !defined TIMEOUT_COMBO_2
#define TIMEOUT_COMBO_2 175
#endif
#if !defined TIMEOUT_COMBO_3
#define TIMEOUT_COMBO_3 175
#endif
#if !defined TIMEOUT_COMBO_4
#define TIMEOUT_COMBO_4 175
#endif
#if !defined TIMEOUT_LAYER_HOLD
#define TIMEOUT_LAYER_HOLD 200
#endif
#if !defined TIMEOUT_STICKY_LEADER_KEY
#define TIMEOUT_STICKY_LEADER_KEY 5000
#endif
&sk {
	release-after-ms = <TIMEOUT_STICKY_LEADER_KEY>;
};
&sl {
	release-after-ms = <TIMEOUT_STICKY_LEADER_KEY>;
};
&mmv {
	time-to-max-speed-ms = <0>;
};
&msc {
	time-to-max-speed-ms = <0>;
};

/*****************************************
 * Define custom layer
 *
 * You can override this layer by copy/pasting the into your keymap *before* including the ardux.dtsi file
 * Once added to your keymap you can adjust as you see fit
*****************************************/
#if !defined ARDUX_LAYER_CUSTOM
#define ARDUX_LAYER_CUSTOM                                            \
		custom {                                                       \
			display-name = "Custom";                                          \
			bindings = <                                               \
				&none               &kp C_VOL_UP  &kp INS   &kp C_MUTE \
				&mo LAYER_ID_CUSTOM &kp C_VOL_DN  &kp PSCRN &sk RSHFT  \
			>;                                                         \
		};
#endif


/*****************************************
 * Layer IDs - if you add / remove / move layers,
 * please change these :)
 *****************************************/
#define LAYER_ID_GLOBAL -1
#define LAYER_ID_BASE 0
#define LAYER_ID_NUMBERS 1
#define LAYER_ID_SYMBOLS 2
#define LAYER_ID_LAYER_SWITCH 3
#define LAYER_ID_NAVIGATION 4
#define LAYER_ID_BT_SEL 5
#define LAYER_ID_MOUSE 6
#define LAYER_ID_OTHER 7
#define LAYER_ID_CUSTOM 8


/*****************************************
 * Standard ARDUX combo definitions
 * These should NOT be changed and are global in scope
 *****************************************/
/ {
	combos {
		compatible = "zmk,combos";
		/*****************************************
		 * 2 key combos
		 *****************************************/
		combo_enter      { timeout-ms = <TIMEOUT_COMBO_2>; key-positions = <KEY_N KEY_E>; bindings = <&kp ENTER>; };
		combo_backspace  { timeout-ms = <TIMEOUT_COMBO_2>; key-positions = <KEY_E KEY_I>; bindings = <&kp BACKSPACE>; };
		combo_delete     { timeout-ms = <TIMEOUT_COMBO_2>; key-positions = <KEY_T KEY_I>; bindings = <&kp DELETE>; };


//		combo_control    { timeout-ms = <TIMEOUT_COMBO_2>; key-positions = <KEY_E KEY_R>; bindings = <&sk LCTRL>; };
//		combo_gui        { timeout-ms = <TIMEOUT_COMBO_2>; key-positions = <KEY_O KEY_R>; bindings = <&sk LGUI>; };
//		combo_alt        { timeout-ms = <TIMEOUT_COMBO_2>; key-positions = <KEY_T KEY_R>; bindings = <&sk LALT>; };
//		combo_shift_lock { timeout-ms = <TIMEOUT_COMBO_2>; key-positions = <KEY_I KEY_O>; bindings = <&kt LSHFT>; };




		combo_b           { layers = <LAYER_ID_BASE>; timeout-ms = <TIMEOUT_COMBO_2>; key-positions = <KEY_SP KEY_E>; bindings = <&kp B>; };
		combo_c           { layers = <LAYER_ID_BASE>; timeout-ms = <TIMEOUT_COMBO_2>; key-positions = <KEY_E KEY_O>; bindings = <&kp C>; };
		combo_d           { layers = <LAYER_ID_BASE>; timeout-ms = <TIMEOUT_COMBO_2>; key-positions = <KEY_N KEY_A>; bindings = <&kp D>; };

		combo_f           { layers = <LAYER_ID_BASE>; timeout-ms = <TIMEOUT_COMBO_2>; key-positions = <KEY_N KEY_I>; bindings = <&kp F>; };
		combo_g           { layers = <LAYER_ID_BASE>; timeout-ms = <TIMEOUT_COMBO_2>; key-positions = <KEY_I KEY_A>; bindings = <&kp G>; };
		combo_h           { layers = <LAYER_ID_BASE>; timeout-ms = <TIMEOUT_COMBO_2>; key-positions = <KEY_E KEY_T>; bindings = <&kp H>; };

		combo_j           { layers = <LAYER_ID_BASE>; timeout-ms = <TIMEOUT_COMBO_2>; key-positions = <KEY_A KEY_R>; bindings = <&kp J>; };
		combo_k           { layers = <LAYER_ID_BASE>; timeout-ms = <TIMEOUT_COMBO_2>; key-positions = <KEY_O KEY_SP>; bindings = <&kp K>; };
		combo_l           { layers = <LAYER_ID_BASE>; timeout-ms = <TIMEOUT_COMBO_2>; key-positions = <KEY_R KEY_SP>; bindings = <&kp L>; };
		combo_m           { layers = <LAYER_ID_BASE>; timeout-ms = <TIMEOUT_COMBO_2>; key-positions = <KEY_T KEY_SP>; bindings = <&kp M>; };
		combo_n           { layers = <LAYER_ID_BASE>; timeout-ms = <TIMEOUT_COMBO_2>; key-positions = <KEY_T KEY_SP>; bindings = <&kp N>; };

		combo_p           { layers = <LAYER_ID_BASE>; timeout-ms = <TIMEOUT_COMBO_2>; key-positions = <KEY_R KEY_O>; bindings = <&kp P>; };
		combo_q           { layers = <LAYER_ID_BASE>; timeout-ms = <TIMEOUT_COMBO_2>; key-positions = <KEY_A KEY_E>; bindings = <&kp Q>; };

		combo_s           { layers = <LAYER_ID_BASE>; timeout-ms = <TIMEOUT_COMBO_2>; key-positions = <KEY_R KEY_T>; bindings = <&kp S>; };

		combo_u           { layers = <LAYER_ID_BASE>; timeout-ms = <TIMEOUT_COMBO_2>; key-positions = <KEY_O KEY_T>; bindings = <&kp U>; };
		combo_v           { layers = <LAYER_ID_BASE>; timeout-ms = <TIMEOUT_COMBO_2>; key-positions = <KEY_I KEY_R>; bindings = <&kp V>; };
		combo_w           { layers = <LAYER_ID_BASE>; timeout-ms = <TIMEOUT_COMBO_2>; key-positions = <KEY_N KEY_R>; bindings = <&kp W>; };
		combo_x           { layers = <LAYER_ID_BASE>; timeout-ms = <TIMEOUT_COMBO_2>; key-positions = <KEY_A KEY_O>; bindings = <&kp X>; };
		combo_y           { layers = <LAYER_ID_BASE>; timeout-ms = <TIMEOUT_COMBO_2>; key-positions = <KEY_I KEY_O>; bindings = <&kp Y>; };
		combo_z           { layers = <LAYER_ID_BASE>; timeout-ms = <TIMEOUT_COMBO_2>; key-positions = <KEY_SP KEY_I>; bindings = <&kp Z>; };

		combo_period      { layers = <LAYER_ID_BASE>; timeout-ms = <TIMEOUT_COMBO_2>; key-positions = <KEY_N KEY_O>; bindings = <&kp PERIOD>; };
		combo_comma       { layers = <LAYER_ID_BASE>; timeout-ms = <TIMEOUT_COMBO_2>; key-positions = <KEY_N KEY_T>; bindings = <&kp COMMA>; };
		combo_slash       { layers = <LAYER_ID_BASE>; timeout-ms = <TIMEOUT_COMBO_2>; key-positions = <KEY_N KEY_SP>; bindings = <&kp SLASH>; };
		combo_exclamation { layers = <LAYER_ID_BASE>; timeout-ms = <TIMEOUT_COMBO_2>; key-positions = <KEY_A KEY_T>; bindings = <&kp EXCL>; };

// Keep numbers the same for Rain Toe as Ardux.
		combo_seven { layers = <LAYER_ID_NUMBERS>; timeout-ms = <TIMEOUT_COMBO_2>; key-positions = <KEY_N KEY_I>; bindings = <&kp N7>; };
		combo_eight { layers = <LAYER_ID_NUMBERS>; timeout-ms = <TIMEOUT_COMBO_2>; key-positions = <KEY_I KEY_A>; bindings = <&kp N8>; };
		combo_nine  { layers = <LAYER_ID_NUMBERS>; timeout-ms = <TIMEOUT_COMBO_2>; key-positions = <KEY_E KEY_O>; bindings = <&kp N9>; };
		combo_zero  { layers = <LAYER_ID_NUMBERS>; timeout-ms = <TIMEOUT_COMBO_2>; key-positions = <KEY_O KEY_T>; bindings = <&kp N0>; };

		combo_num_period { layers = <LAYER_ID_NUMBERS>; timeout-ms = <TIMEOUT_COMBO_2>; key-positions = <KEY_O KEY_N>; bindings = <&kp PERIOD>; };
		combo_num_comma { layers = <LAYER_ID_NUMBERS>; timeout-ms = <TIMEOUT_COMBO_2>; key-positions = <KEY_T KEY_N>; bindings = <&kp COMMA>; };
		combo_num_enter  { layers = <LAYER_ID_NUMBERS>; timeout-ms = <TIMEOUT_COMBO_2>; key-positions = <KEY_E KEY_N>; bindings = <&kp ENTER>; };

		/*****************************************
		 * 3 key combos
		 *****************************************/
		combo_esc              { timeout-ms = <TIMEOUT_COMBO_3>; key-positions = <KEY_N KEY_I KEY_SP>; bindings = <&kp ESC>; };
		combo_layer_navigation { timeout-ms = <TIMEOUT_COMBO_3>; key-positions = <KEY_I KEY_E KEY_T>; bindings = <&tog LAYER_ID_NAVIGATION>; };
		combo_layer_mouse      { timeout-ms = <TIMEOUT_COMBO_3>; key-positions = <KEY_N KEY_A KEY_O>; bindings = <&tog LAYER_ID_MOUSE>; };

		combo_single_quote { layers = <LAYER_ID_BASE>; timeout-ms = <TIMEOUT_COMBO_3>; key-positions = <KEY_N KEY_O KEY_T>; bindings = <&kp SQT>; };

		/*****************************************
		 * 4 key combos
		 *****************************************/
		combo_tab             { timeout-ms = <TIMEOUT_COMBO_4>; key-positions = <KEY_N KEY_I KEY_A KEY_SP>; bindings = <&kp TAB>; };

		combo_shift           { timeout-ms = <TIMEOUT_COMBO_4>; key-positions = <KEY_E KEY_I KEY_A KEY_R>; bindings = <&sk LSHFT>; };
		combo_layer_bt_select { timeout-ms = <TIMEOUT_COMBO_4>; key-positions = <KEY_N KEY_E KEY_R KEY_SP>; bindings = <&tog LAYER_ID_BT_SEL>; };
		combo_bt_clr          { timeout-ms = <TIMEOUT_COMBO_4>; key-positions = <KEY_I KEY_O KEY_A KEY_T>; bindings = <&bt BT_CLR>; };


		combo_caps_lock { layers = <LAYER_ID_BASE>; timeout-ms = <TIMEOUT_COMBO_4>; key-positions = <KEY_SP KEY_T KEY_O KEY_N>; bindings = <&kp CAPS>; };
	};
};

/*****************************************
 * Standard ARDUX layer definitions
 * !!!!!!!!!! FOR LEFT HANDED USE !!!!!!!!!!
 *****************************************/
#if defined ARDUX_LEFT
/ {
	keymap {
		compatible = "zmk,keymap";
		base {
			display-name = "rain toe4";
			bindings = <
				&lt LAYER_ID_NUMBERS R        &kp A     &kp I     &lt LAYER_ID_LAYER_SWITCH N
				&lt LAYER_ID_CUSTOM SPACE     &kp T     &kp O     &lt LAYER_ID_SYMBOLS E
			>;
		};

		numbers {
			display-name = "Number";
			bindings = <
				&mo LAYER_ID_NUMBERS                        &kp N3    &kp N2    &kp N1
				&none                                       &kp N6    &kp N5    &kp N4
			>;
		};
		symbols {
			display-name = "Symbol";
			bindings = <
				&kp GRAVE                                   &kp SEMI  &kp BSLH  &kp EXCL
				&kp EQUAL                                   &kp MINUS &kp QMARK &mo LAYER_ID_SYMBOLS
			>;
		};
		parentheticals {
			display-name = "layers";
			bindings = <
				&kp LBRC                                    &kp LPAR  &kp RPAR  &mo  LAYER_ID_LAYER_SWITCH
				&kp RBRC                                    &kp LBKT  &kp RBKT  &none
			>;
		};
		navigation {
			display-name = "Nav";
			bindings = <
				&kp PG_UP                                   &kp HOME  &kp UP    &kp END
				&kp PG_DN                                   &kp LEFT  &kp DOWN  &kp RIGHT
			>;
		};
		bt {
			display-name = "BT";
			bindings = <
				ARDUX_BT_TOP    &bt BT_SEL 2 &bt BT_SEL 1 &bt BT_SEL 0
				ARDUX_BT_BOTTOM &bt BT_SEL 5 &bt BT_SEL 4 &bt BT_SEL 3
			>;
		};
		mouse {
			display-name = "Mouse";
			bindings = <
				&msc SCRL_UP     &mkp RCLK  &mmv MOVE_UP    &mkp LCLK
				&msc SCRL_DOWN   &mmv MOVE_LEFT  &mmv MOVE_DOWN  &mmv MOVE_RIGHT
			>;
		};
		other {
			display-name = "other";
			bindings = <
				&msc SCRL_UP     &mkp RCLK  &mmv MOVE_UP    &mkp LCLK
				&msc SCRL_DOWN   &mmv MOVE_LEFT  &mmv MOVE_DOWN  &mmv MOVE_RIGHT
			>;
		};

		ARDUX_LAYER_CUSTOM
	};
};
#endif
