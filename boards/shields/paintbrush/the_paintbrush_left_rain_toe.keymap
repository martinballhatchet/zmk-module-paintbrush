#include <behaviors.dtsi>
#include <dt-bindings/zmk/keys.h>
#include <dt-bindings/zmk/bt.h>

#include "raintoe.dtsi"

/*

* Started with Ardux and heavily modified to make a new, different layout - "rain toe"
* This is intended to just be an 8 key layout; not extended.
* It's primarily left-handed. Might make a right-handed version later.
* I like the concept of Big Ardux etc, but I don't need them and want to
* concentrate on getting "rain toe" working first.
* Layout editable in the amazing https://nickcoutsos.github.io/keymap-editor/
*/

/*
TODO: Fix build of rain_toe variant
TODO: Might need to reset my ZMK Config - create a new one probably
TODO: layers aren't working quite right. can't switch back from some

TODO: Rest of keys
TODO: Switch out display
TODO: Try a few different mod behaviours
TODO: Mod toggle when hold, sticky when tap
TODO: Can we clear toggles?
TODO: Bluetooth? profile 6
TODO: Other layers
DONE: Media pause, volume up and down
TODO: What other weird stuff can we do?
TODO: Functions (like numbers) - add some more
TODO: Put Ardux back as default but Rain Toe is a left sibling
TODO: ?Put back right-handed? NIAR EOT :)
TODO: Bluetooth on/off
TODO: Put layout somewhere

*/
